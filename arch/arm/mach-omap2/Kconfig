## drivers/media/video/omap/Kconfig
```kconfig
menu "OMAP16xx V4L2 drivers"
	depends on VIDEO_DEV && ARCH_OMAP16XX
config VIDEO_OMAP_CAMERA
	tristate "OMAP Camera support (EXPERIMENTAL)"
	select VIDEO_BUF
	depends on VIDEO_DEV && (ARCH_OMAP16XX || ARCH_OMAP24XX)
	help
	  V4L2 camera driver support for OMAP1/2 based boards.
	
config VIDEO_CAMERA_SENSOR_OV9640
	tristate "OV9640 sensor support"
	depends on VIDEO_OMAP_CAMERA
	help
	  OmniVision 9640 camera sensor support
endmenu

menu "OMAP2/OMAP3 V4L2 drivers"
	depends on VIDEO_DEV && (ARCH_OMAP24XX || ARCH_OMAP34XX)

config VIDEO_OMAP24XX_VIDEOLIB
	tristate "Video out library"

config VIDEO_OMAP_RESZ
	tristate "Omap Image Resizer"
	help
	  Support for Omap3430 builtin Image Resizer module

	  To compile this driver a s a module, choose M here: the
	  module will be called omap-resz.

config VIDEO_OMAP_IMGDMA
	tristate "Omap Image DMA"
	default m
	help
	  Support for fast 2D Image DMA using EDMA3 controller

	  To compile this driver a s a module, choose M here: the
	  module will be called omap-imgdma.

config VIDEO_OMAP24XX_VIDEOOUT
	tristate "Video out driver"
	depends on VIDEO_OMAP24XX_VIDEOLIB
	select VIDEO_BUF

config VIDEO_OMAP24XX_TVOUT
	bool "TV out support"

config VIDEO_OMAP24XX_CAMERA
	tristate "Camera driver"
	depends on VIDEO_OMAP24XX_VIDEOLIB && ARCH_OMAP24XX 
	select VIDEO_BUF

config VIDEO_OMAP34XX_CAMERA
	tristate "Camera driver"
	depends on VIDEO_OMAP24XX_VIDEOLIB && ARCH_OMAP34XX 
	select VIDEO_BUF

config VIDEO_OMAP34XX_ARCDVB
	tristate "Archos DVB CCDC Driver"
	depends on VIDEO_OMAP24XX_VIDEOLIB && ARCH_OMAP34XX 
	select VIDEO_BUF

config VIDEO_OMAP34XX_DVR
	tristate "Video decoder driver"
	depends on VIDEO_OMAP24XX_VIDEOLIB && ARCH_OMAP34XX
	select VIDEO_BUF

config VIDEO_OMAP_SENSOR_MT9D111
	tristate "Micron mt9d111 (EX3691) ISP sensor driver"
	depends on ARCH_OMAP2430 || ARCH_OMAP34XX  

config VIDEO_OMAP_SENSOR_MT9T012
	tristate "Micron mt9t012 raw sensor driver (3MP)"
	depends on ARCH_OMAP34XX  && !OMAP3430_ES2
	default y

config VIDEO_OMAP_SENSOR_MT9P012
	tristate "Micron mt9p012 raw sensor driver (5MP)"
	depends on ARCH_OMAP34XX && OMAP3430_ES2
	default y

config VIDEO_OMAP_AF_D88
	tristate "Auto Focus driver coil D88"
	depends on ARCH_OMAP34XX && VIDEO_OMAP_SENSOR_MT9P012 && OMAP3430_ES2
	default y
	

source "drivers/media/video/omap/isp/Kconfig"
source "drivers/media/video/omap/gci/Kconfig"
endmenu
```

## drivers/media/video/omap/isp/Kconfig
```kconfig
config VIDEO_OMAP34XX_ISP
	tristate "omap isp driver"
	depends on ARCH_OMAP34XX 
```

## kernel/power/Kconfig
```kconfig
config PM
	bool "Power Management support"
	depends on !IA64_HP_SIM
	---help---
	  "Power Management" means that parts of your computer are shut
	  off or put into a power conserving "sleep" mode if they are not
	  being used.  There are two competing standards for doing this: APM
	  and ACPI.  If you want to use either one, say Y here and then also
	  to the requisite support below.

	  Power Management is most important for battery powered laptop
	  computers; if you have a laptop, check out the Linux Laptop home
	  page on the WWW at <http://www.linux-on-laptops.com/> or
	  Tuxmobil - Linux on Mobile Computers at <http://www.tuxmobil.org/>
	  and the Battery Powered Linux mini-HOWTO, available from
	  <http://www.tldp.org/docs.html#howto>.

	  Note that, even if you say N here, Linux on the x86 architecture
	  will issue the hlt instruction if nothing is to be done, thereby
	  sending the processor to sleep and saving power.

config PM_LEGACY
	bool "Legacy Power Management API (DEPRECATED)"
	depends on PM
	default n
	---help---
	   Support for pm_register() and friends.  This old API is obsoleted
	   by the driver model.

	   If unsure, say N.

config PM_DEBUG
	bool "Power Management Debug Support"
	depends on PM
	---help---
	This option enables verbose debugging support in the Power Management
	code. This is helpful when debugging and reporting various PM bugs, 
	like suspend support.

config DISABLE_CONSOLE_SUSPEND
	bool "Keep console(s) enabled during suspend/resume (DANGEROUS)"
	depends on PM && PM_DEBUG
	default n
	---help---
	This option turns off the console suspend mechanism that prevents
	debug messages from reaching the console during the suspend/resume
	operations.  This may be helpful when debugging device drivers'
	suspend/resume routines, but may itself lead to problems, for example
	if netconsole is used.

config PM_TRACE
	bool "Suspend/resume event tracing"
	depends on PM && PM_DEBUG && X86_32 && EXPERIMENTAL
	default n
	---help---
	This enables some cheesy code to save the last PM event point in the
	RTC across reboots, so that you can debug a machine that just hangs
	during suspend (or more commonly, during resume).

	To use this debugging feature you should attempt to suspend the machine,
	then reboot it, then run

		dmesg -s 1000000 | grep 'hash matches'

	CAUTION: this option will cause your machine's real-time clock to be
	set to an invalid time after a resume.

config PM_SYSFS_DEPRECATED
	bool "Driver model /sys/devices/.../power/state files (DEPRECATED)"
	depends on PM && SYSFS
	default n
	help
	  The driver model started out with a sysfs file intended to provide
	  a userspace hook for device power management.  This feature has never
	  worked very well, except for limited testing purposes, and so it will
	  be removed.   It's not clear that a generic mechanism could really
	  handle the wide variability of device power states; any replacements
	  are likely to be bus or driver specific.

config SOFTWARE_SUSPEND
	bool "Software Suspend (Hibernation)"
	depends on PM && SWAP && (((X86 || PPC64_SWSUSP) && (!SMP || SUSPEND_SMP)) || ((FRV || PPC32) && !SMP))
	---help---
	  Enable the suspend to disk (STD) functionality, which is usually
	  called "hibernation" in user interfaces.  STD checkpoints the
	  system and powers it off; and restores that checkpoint on reboot.

	  You can suspend your machine with 'echo disk > /sys/power/state'.
	  Alternatively, you can use the additional userland tools available
	  from <http://suspend.sf.net>.

	  In principle it does not require ACPI or APM, although for example
	  ACPI will be used for the final steps when it is available.  One
	  of the reasons to use software suspend is that the firmware hooks
	  for suspend states like suspend-to-RAM (STR) often don't work very
	  well with Linux.

	  It creates an image which is saved in your active swap. Upon the next
	  boot, pass the 'resume=/dev/swappartition' argument to the kernel to
	  have it detect the saved image, restore memory state from it, and
	  continue to run as before. If you do not want the previous state to
	  be reloaded, then use the 'noresume' kernel command line argument.
	  Note, however, that fsck will be run on your filesystems and you will
	  need to run mkswap against the swap partition used for the suspend.

	  It also works with swap files to a limited extent (for details see
	  <file:Documentation/power/swsusp-and-swap-files.txt>).

	  Right now you may boot without resuming and resume later but in the
	  meantime you cannot use the swap partition(s)/file(s) involved in
	  suspending.  Also in this case you must not use the filesystems
	  that were mounted before the suspend.  In particular, you MUST NOT
	  MOUNT any journaled filesystems mounted before the suspend or they
	  will get corrupted in a nasty way.

	  For more information take a look at <file:Documentation/power/swsusp.txt>.

config PM_STD_PARTITION
	string "Default resume partition"
	depends on SOFTWARE_SUSPEND
	default ""
	---help---
	  The default resume partition is the partition that the suspend-
	  to-disk implementation will look for a suspended disk image. 

	  The partition specified here will be different for almost every user. 
	  It should be a valid swap partition (at least for now) that is turned
	  on before suspending. 

	  The partition specified can be overridden by specifying:

		resume=/dev/<other device> 

	  which will set the resume partition to the device specified. 

	  Note there is currently not a way to specify which device to save the
	  suspended image to. It will simply pick the first available swap 
	  device.

config SUSPEND_SMP
	bool
	depends on HOTPLUG_CPU && (X86 || PPC64) && PM
	default y

config APM_EMULATION
	tristate "Advanced Power Management Emulation"
	depends on PM && SYS_SUPPORTS_APM_EMULATION
	help
	  APM is a BIOS specification for saving power using several different
	  techniques. This is mostly useful for battery powered laptops with
	  APM compliant BIOSes. If you say Y here, the system time will be
	  reset after a RESUME operation, the /proc/apm device will provide
	  battery status information, and user-space programs will receive
	  notification of APM "events" (e.g. battery status change).

	  In order to use APM, you will need supporting software. For location
	  and more information, read <file:Documentation/pm.txt> and the
	  Battery Powered Linux mini-HOWTO, available from
	  <http://www.tldp.org/docs.html#howto>.

	  This driver does not spin down disk drives (see the hdparm(8)
	  manpage ("man 8 hdparm") for that), and it doesn't turn off
	  VESA-compliant "green" monitors.

	  Generally, if you don't have a battery in your machine, there isn't
	  much point in using this driver and you should say N. If you get
	  random kernel OOPSes or reboots that don't seem to be related to
	  anything, try disabling/enabling this option (or disabling/enabling
	  APM in your BIOS).

config HDD_DPM
	bool "Dynamic HDD power management"
	depends on PM

menu "OMAP power management options"
	depends on ARCH_OMAP 
choice
	prompt "Choose Voltage Scale method"
	default OMAP_VOLT_SR_BYPASS

config OMAP_VOLT_SR_BYPASS
	bool "Voltage Scale via Smart Reflex in bypass"
	depends on ARCH_OMAP3
	help
	Voltage scaling using direct register writes to OMAP3 voltage processor

config OMAP_VOLT_SR
	bool "Voltage scaling using Smart Reflex convergence"
	depends on ARCH_OMAP3
	help
	Voltage scaling using error feedback on OMAP3 voltage processor

config OMAP_VOLT_VSEL
	bool "Voltage scaling using VSEL writes"
	help
	Voltage scaling by OMAP2/3 I2C writes to Triton2 power chip

config OMAP_VOLT_VMODE
	bool "Voltage scaling using VMODE pins"
	help
	Voltage scaling using by OMAP2/3 VMODE pin toggling
endchoice

comment "Default VDD1 OPP Level Selection"

choice
	prompt "VDD1 OPP"
	depends on ARCH_OMAP34XX && !OMAP3430_ES2
	default OMAP3ES1_VDD1_OPP1

config OMAP3ES1_VDD1_OPP1
	bool "MPU-476Mhz/DSP-313Mhz(OPP1)"
	depends on ARCH_OMAP34XX
	help
	  Select this option if you want to boot at OPP1.

config OMAP3ES1_VDD1_OPP2
	bool "MPU-381Mhz/DSP-250Mhz(OPP2)"
	depends on ARCH_OMAP34XX
	help
	  Select this option if you want to boot at OPP2.

config OMAP3ES1_VDD1_OPP3
	bool "MPU-190Mhz/DSP-125Mhz(OPP3)"
	depends on ARCH_OMAP34XX
	help
	  Select this option if you want to boot at OPP3.

config OMAP3ES1_VDD1_OPP4
	bool "MPU-96Mhz/DSP-63Mhz(OPP4)"
	depends on ARCH_OMAP34XX
	help
	  Select this option if you want to boot at OPP4.

endchoice

choice
	prompt "VDD1 OPP"
	depends on ARCH_OMAP34XX && OMAP3430_ES2
	default OMAP3ES2_VDD1_OPP3

config OMAP3ES2_VDD1_OPP1
	bool "MPU-125Mhz/DSP-90Mhz(OPP1)"
	depends on ARCH_OMAP34XX
	help
	  Select this option if you want to boot at OPP1.

config OMAP3ES2_VDD1_OPP2
	bool "MPU-250Mhz/DSP-180Mhz(OPP2)"
	depends on ARCH_OMAP34XX
	help
	  Select this option if you want to boot at OPP2.

config OMAP3ES2_VDD1_OPP3
	bool "MPU-500Mhz/DSP-360Mhz(OPP3)"
	depends on ARCH_OMAP34XX
	help
	  Select this option if you want to boot at OPP3.

config OMAP3ES2_VDD1_OPP4
	bool "MPU-550Mhz/DSP-396Mhz(OPP4)"
	depends on ARCH_OMAP34XX
	help
	  Select this option if you want to boot at OPP4.

config OMAP3ES2_VDD1_OPP5
	bool "MPU-625Mhz/DSP-430Mhz(OPP5)"
	depends on ARCH_OMAP34XX
	help
	  Select this option if you want to boot at OPP5.

endchoice

comment "Default VDD2 OPP Level Selection"

choice
	prompt "Set VDD2-CORE Domain Frequency"
	depends on ARCH_OMAP34XX
	default OMAP3_CORE_166MHZ

config OMAP3_CORE_133MHZ
	bool "CORE at 133MHz"
	depends on ARCH_OMAP34XX
	help
	  Select this option to set CORE frequency to 133MHz (max memory and interconnect clock)

config OMAP3_CORE_166MHZ
	bool "CORE at 166MHz"
	depends on ARCH_OMAP34XX
	help
	  Select this option to set CORE frequency to 166MHz (max memory and interconnect clock)

endchoice

choice
	prompt "VDD2 OPP"
	depends on ARCH_OMAP34XX && OMAP3430_ES2
	default OMAP3ES2_VDD2_OPP3

config OMAP3ES2_VDD2_OPP2
	bool "CORE/L3 83/66MHz(OPP2)"
	depends on ARCH_OMAP34XX
	help
	  Select this option if you want to boot at VDD2 OPP2.

config OMAP3ES2_VDD2_OPP3
	bool "CORE/L3 166MHz/133MHz(OPP3)"
	depends on ARCH_OMAP34XX
	help
	  Select this option if you want to boot at VDD2 OPP2.

endchoice

config ENABLE_VOLTSCALE_IN_SUSPEND
	bool "Enable Voltage scaling during Supend/Resume"
	depends on ARCH_OMAP34XX
	default n
	---help---
	This option is for voltage scaling during Suspend/Resume.

config MPU_OFF
	bool "Enable MPU off in suspend/resume and cpuidle"
	depends on ARCH_OMAP34XX  && OMAP3430_ES2
	default n
	---help---
	This option is for enabling MPU domain to go to OFF state in cpuidle and suspend/resume.	

config OMAP34XX_OFFMODE
	bool "Enable OFF Mode for 3430"
	depends on ARCH_OMAP34XX
	default n
	---help---
	This option enables all off modes frameworks and allows power domains to go to off with context save/restore

config CORE_OFF
	bool "Enable CORE off"
	depends on MPU_OFF && OMAP34XX_OFFMODE
	---help---
	This option is for enabling CORE domain to go to OFF state in suspend/resume

config CORE_OFF_CPUIDLE
	bool "Enable CORE off in cpuidle"
	depends on CORE_OFF
	default n
	---help---
	This option is for enabling CORE domain to go to OFF state in cpuidle

config SYSOFFMODE
	bool "Enable sysoff mode and VDD1/2 scaling to 0V"
	depends on CORE_OFF
	default n
	---help---
	This option is for enabling sysoffmode when chip off happens

config HW_SUP_TRANS
	bool "OMAP3430 enable H/W supervised transition for clock domains"
	depends on ARCH_OMAP3 && ARCH_OMAP34XX
	default n

config TRACK_RESOURCES 
	bool "Enable resource tracking"
	depends on ARCH_OMAP34XX
	default n
	---help---
	This option enables tracking of resources such as clock and voltage sources. 

config	AUTO_POWER_DOMAIN_CTRL 
	bool "Enable automatic power domain control"
	depends on ARCH_OMAP34XX
	default y
	---help---
	This option enables automatic control of power domains through the clock framework. 

config PREVENT_MPU_RET
	bool "Prevent Mpu retention"
	depends on ARCH_OMAP34XX
	default n
	---help---
	This option is for disabling mpu retention through osidle during bootup.It can be changed later using sysfs interface.

config PREVENT_CORE_RET
	bool "Prevent Core retention"
	depends on ARCH_OMAP34XX
	default n
	---help---
	This option is for disabling core retention through osidle during bootup.It can be changed later using sysfs interface.

config DISABLE_EMUDOMAIN_CONTROL
	bool "Disable h/w supervised control of EMU clock domain"
	depends on ARCH_OMAP34XX
	default y
	---help---
	This option is for disabling h/w supervised control of EMU clock domain. Required for debugging using JTAG
choice
	prompt "SmartReflex mode"
	depends on ARCH_OMAP34XX && !OMAP_VOLT_VMODE
	default ENABLE_SR_CLASS2

config ENABLE_SR_CLASS2
	bool "Class2"
	depends on ARCH_OMAP34XX && (OMAP_VOLT_VSEL || OMAP_VOLT_SR_BYPASS) && !OMAP_VOLT_SR
	help
	  SmartReflex Class2 - Fully automatic voltage scaling using software feedback loop

config ENABLE_SR_CLASS3
	bool "Class3"
	depends on ARCH_OMAP3 && TWL4030_CORE && !OMAP_VOLT_VSEL && (OMAP_VOLT_SR_BYPASS || OMAP_VOLT_SR)
	help
	  SmartReflex Class3 - Fully automatic voltage scaling using hardware feedback loop
endchoice
endmenu
```
