## arch/arm/mach-omap2/Kconfig
```kconfig
comment "OMAP Core Type"
	depends on ARCH_OMAP2

config ARCH_OMAP24XX
	bool "OMAP24xx Based System"
	depends on ARCH_OMAP2

config ARCH_OMAP34XX
	bool "OMAP34xx Based System"
	depends on ARCH_OMAP3

config ARCH_OMAP2420
	bool "OMAP2420 support"
	depends on ARCH_OMAP24XX
	select OMAP_DM_TIMER
	select ARCH_OMAP_OTG

config ARCH_OMAP2430
	bool "OMAP2430 support"
	depends on ARCH_OMAP24XX

config ARCH_OMAP3430
	bool "OMAP3430 support"
	depends on ARCH_OMAP3 && ARCH_OMAP34XX

config OMAP3430_ES2
	bool "OMAP3430 ES2 support"
	depends on ARCH_OMAP3 && ARCH_OMAP34XX
	default y

config ARCH_OMAP3410
	bool "OMAP3410 support"
	depends on ARCH_OMAP3 && ARCH_OMAP34XX && OMAP3430_ES2
	
comment "OMAP Board Type"
	depends on ARCH_OMAP2 || ARCH_OMAP3

config MACH_OMAP_GENERIC
	bool "Generic OMAP board"
	depends on ARCH_OMAP2 && ARCH_OMAP24XX

config MACH_NOKIA_N800
	bool "Nokia N800"
	depends on ARCH_OMAP24XX

config MACH_OMAP2_TUSB6010
	bool
	depends on ARCH_OMAP2 && ARCH_OMAP2420
	default y if MACH_NOKIA_N800

config MACH_OMAP_H4
	bool "OMAP 2420 H4 board"
	depends on ARCH_OMAP2 && ARCH_OMAP24XX
	select OMAP_DEBUG_DEVICES
	select GPIOEXPANDER_OMAP

config MACH_OMAP_3430SDP
	bool "OMAP 3430 SDP board"
	depends on ARCH_OMAP3 && ARCH_OMAP34XX

config MACH_OMAP3_EVM
	bool "OMAP3 EVM board"
        depends on ARCH_OMAP3 && ARCH_OMAP34XX

config MACH_OMAP_H4_TUSB
	bool "TUSB 6010 EVM board"
	depends on MACH_OMAP_H4
	select MACH_OMAP2_TUSB6010
	help
	  Set this if you've got a TUSB6010 high speed USB board.
	  You may need to consult the schematics for your revisions
	  of the Menelaus and TUSB boards, and make changes to be
	  sure this is set up properly for your board stack.

	  Be sure to select OTG mode operation, not host-only or
	  peripheral-only.

config MACH_OMAP_H4_OTG
	bool "Use USB OTG connector, not device connector (S1.10)"
	depends on MACH_OMAP_H4
	help
	  Set this if you've set S1.10 (on the mainboard) to use the
	  Mini-AB (OTG) connector and OTG transceiver with the USB0
	  port, instead of the Mini-B ("download") connector with its
	  non-OTG transceiver.

	  Note that the "download" connector can be used to bootstrap
	  the system from the OMAP mask ROM.  Also, since this is a
	  development platform, you can also force the OTG port into
	  a non-OTG operational mode.

config MACH_OMAP2_H4_USB1
	bool "Use USB1 port, not UART2 (S3.3)"
	depends on MACH_OMAP_H4
	help
	  Set this if you've set SW3.3 (on the CPU card) so that the
	  expansion connectors receive USB1 signals instead of UART2.

config MACH_OMAP_APOLLON
	bool "OMAP 2420 Apollon board"
	depends on ARCH_OMAP2 && ARCH_OMAP24XX

config MACH_OMAP_APOLLON_PLUS
	bool "OMAP 2420 Apollon Plus board"
	select MACH_OMAP_APOLLON
	help
	  It contains more LEDs, SWs, and so on

	  Note that it is only tested with version 1.1 and more
	  We have to test the version 1.0

config MACH_OMAP_2430SDP
	bool "OMAP 2430 SDP board"
	depends on ARCH_OMAP2 && ARCH_OMAP24XX

config MACH_ARCHOS_G6S
	bool "ARCHOS G6S support"
	depends on ARCH_OMAP3 && ARCH_OMAP34XX && OMAP3430_ES2

config MACH_ARCHOS_G6H
	bool "ARCHOS G6H support"
	depends on ARCH_OMAP3 && ARCH_OMAP34XX && OMAP3430_ES2

config MACH_ARCHOS_G6PLUS
	bool "ARCHOS G6PLUS support"
	depends on ARCH_OMAP3 && ARCH_OMAP34XX && OMAP3430_ES2

config MACH_ARCHOS_G6L
	bool "ARCHOS G6L support"
	depends on ARCH_OMAP3 && ARCH_OMAP34XX && OMAP3430_ES2

config MACH_ARCHOS_G6TV
	bool "ARCHOS G6TV support"
	depends on ARCH_OMAP3 && ARCH_OMAP34XX && OMAP3430_ES2

config MACH_ARCHOS_G6
	bool
	default MACH_ARCHOS_G6S || MACH_ARCHOS_G6H || MACH_ARCHOS_G6PLUS || MACH_ARCHOS_G6L || MACH_ARCHOS_G6TV

config ARCHOSG6_FIXUP
	bool "Fixup machine description of Archos Gen6"
	depends on MACH_ARCHOS_G6
	default y if MACH_ARCHOS_G6

config TPS65023
	bool "TPS65023 Power Management chip"
	default MACH_ARCHOS_G6
	help
	  If you say yes here you get support for the TPS65023 series of
	  Power Management chips.  These include voltage regulators and other
	  features that are often used in portable devices like cell phones
	  and cameras.

config FIQ
	bool "Enable Fast Interrupt Support for OMAP3"
	depends on ARCH_OMAP3 && ARCH_OMAP34XX
	default n
	help
	  Configure Fast Interrupt Support

config OMAP3_IRBLASTER_ON_FIQ
	bool "Control irblaster with FIQ"
	depends on FIQ
	default n
	help
	  Select this option if you want to controle irblaster with FIQ

config MACH_OMAP3_IRRGPT9
	bool "Initialization GP Timer9 by dmtimer for IR remote driver"
	depends on INPUT_ARCHOSGEN6_IR

config IRBLASTER_G6
	bool "PWM and Irblaster timer level functions"
	default n
	depends on MACH_ARCHOS_G6 || MACH_OMAP_3430SDP
```

## drivers/i2c/chips/Kconfig
```kconfig
#
# Miscellaneous I2C chip drivers configuration
#

menu "Miscellaneous I2C Chip support"


config SENSORS_ATMEGA
	tristate "ATMEGA micro controller"
	depends on I2C
	help
	  This is a simple adapter driver for the ATMEGA micro
	  controller on the Archos G6

config SENSORS_DS1337
	tristate "Dallas Semiconductor DS1337 and DS1339 Real Time Clock"
	depends on EXPERIMENTAL
	help
	  If you say yes here you get support for Dallas Semiconductor
	  DS1337 and DS1339 real-time clock chips.

	  This driver can also be built as a module.  If so, the module
	  will be called ds1337.

config SENSORS_DS1374
	tristate "Maxim/Dallas Semiconductor DS1374 Real Time Clock"
	depends on EXPERIMENTAL
	help
	  If you say yes here you get support for Dallas Semiconductor
	  DS1374 real-time clock chips.

	  This driver can also be built as a module.  If so, the module
	  will be called ds1374.

config SENSORS_EEPROM
	tristate "EEPROM reader"
	depends on EXPERIMENTAL
	help
	  If you say yes here you get read-only access to the EEPROM data
	  available on modern memory DIMMs and Sony Vaio laptops.  Such
	  EEPROMs could theoretically be available on other devices as well.

	  This driver can also be built as a module.  If so, the module
	  will be called eeprom.

config SENSORS_PCF8574
	tristate "Philips PCF8574 and PCF8574A"
	depends on EXPERIMENTAL
	default n
	help
	  If you say yes here you get support for Philips PCF8574 and
	  PCF8574A chips.

	  This driver can also be built as a module.  If so, the module
	  will be called pcf8574.

	  These devices are hard to detect and rarely found on mainstream
	  hardware.  If unsure, say N.

config SENSORS_PCA9539
	tristate "Philips PCA9539 16-bit I/O port"
	depends on EXPERIMENTAL
	help
	  If you say yes here you get support for the Philips PCA9539
	  16-bit I/O port.

	  This driver can also be built as a module.  If so, the module
	  will be called pca9539.

config SENSORS_PCF8591
	tristate "Philips PCF8591"
	depends on EXPERIMENTAL
	default n
	help
	  If you say yes here you get support for Philips PCF8591 chips.

	  This driver can also be built as a module.  If so, the module
	  will be called pcf8591.

	  These devices are hard to detect and rarely found on mainstream
	  hardware.  If unsure, say N.

config ISP1301_OMAP
	tristate "Philips ISP1301 with OMAP USBHOST"
	depends on USB_OHCI_HCD
	default y
	help
	  If you say yes here you get support for the Philips ISP1301
	  transceiver working with the OMAP SYNOPSYS controller.
	  The ISP1301 is used in products including H2 and H3 development
	  boards for Texas Instruments OMAP processors.

	  This driver can also be built as a module.  If so, the module
	  will be called isp1301_omap.

# NOTE:  This isn't really OMAP-specific, except for the current
# interface location in  <include/asm-arm/arch-omap/tps65010.h>
# and having mostly OMAP-specific board support
config TPS65010
	tristate "TPS6501x Power Management chips"
	depends on ARCH_OMAP
	default y if MACH_OMAP_H2 || MACH_OMAP_H3 || MACH_OMAP_OSK
	help
	  If you say yes here you get support for the TPS6501x series of
	  Power Management chips.  These include voltage regulators,
	  lithium ion/polymer battery charging, and other features that
	  are often used in portable devices like cell phones and cameras.

	  This driver can also be built as a module.  If so, the module
	  will be called tps65010.

config TPS65023ARC
	tristate "TPS65023 Power Management chips"
	depends on ARCH_OMAP
	default m if MACH_ARCHOS_G6
	help
	  If you say yes here you get support for the I2C control
	  interface for the TPS65023 Power Management chips.
	  These include voltage regulators,
	  This driver can also be built as a module.  If so, the module
	  will be called tps65023arc.

config SENSORS_TLV320AIC23
	tristate "Texas Instruments TLV320AIC23 Codec"
	depends on I2C && I2C_OMAP
	help
	  If you say yes here you get support for the I2C control
	  interface for Texas Instruments TLV320AIC23 audio codec.

config GPIOEXPANDER_OMAP
	bool "GPIO Expander PCF8574PWR for OMAP"
	depends on I2C && (ARCH_OMAP16XX || ARCH_OMAP24XX)
	help
	  If you say yes here you get support for I/O expander calls
	  to configure IrDA, Camera and audio devices.

config MENELAUS
	bool "TWL92330/Menelaus PM chip"
	depends on I2C=y && ARCH_OMAP24XX
	help
	  If you say yes here you get support for the Texas Instruments
	  TWL92330/Menelaus Power Management chip. This include voltage
	  regulators, Dual slot memory card tranceivers, real-time clock
	  and other features that are often used in portable devices like
	  cell phones and PDAs.

config SENSORS_WM87XX
        tristate "Wolfson Microelectronics WM87XX i2c driver"
        depends on I2C && ARCH_OMAP34XX
        help
          If you say yes here you get support for the I2C control
          interface for Wolfson Microelectronics WM87XX audio codec.

config AD9X89_CORE
        tristate "AD9X89 core, HDMI chip i2c driver"
        depends on I2C && ARCH_OMAP34XX
        default y
        help
          If you say yes here you get support for the I2C control
          interface for Analog Device AD98XX hdmi chip support.

config AD9X89_EDID
        tristate "AD9X89 edid, HDMI chip i2c driver"
        depends on AD9X89_CORE
        default y
        help
          If you say yes here you get support for EDID for Analog Device AD98XX hdmi chip.

config AD9X89_GMP
        tristate "AD9X89 gmp, HDMI chip i2c driver"
        depends on AD9X89_CORE
        default y
        help
          If you say yes here you get support for GMP for Analog Device AD98XX hdmi chip.

config TWL4030_CORE
	bool "TI's TWL4030 companion chip Core Driver Support"
	depends on I2C=y && (ARCH_OMAP24XX || ARCH_OMAP34XX)
	help
	  Say yes here if you have TWL4030 chip on your board

config TWL4030_IRQ_PRIO
        int "SCHED_FIFO scheduling priority of the TWL4030 irq kernel thread"
        depends on TWL4030_CORE
        default "26"
        help
          The TWL4030 interrupt service routine must read TWL4030 registers via
          the I2C bus.  The I2C driver can't be invoked from interrupt context,
          so the TWL4030 driver must use a kernel thread to complete the
          servicing of interrupts.  This option selects the scheduling priority
          of the kernel thread.

config TWL4030_GPIO
	bool "TWL4030 GPIO Driver"
	depends on TWL4030_CORE

config TWL4030_DBG_SYSFS
	bool "TWL4030 Sysfs Debug Support"
	depends on TWL4030_CORE

config TWL4030_USB
	bool "TWL4030 USB Transceiver Driver"
	default y if (MACH_OMAP3_EVM || MACH_OMAP_3430SDP) && USB_MUSB_HDRC
	depends on TWL4030_CORE

choice
	prompt "Transceiver mode"
	depends on TWL4030_USB
	help
	  TWL4030 USB transceiver can operate in various
	  mutually-exclusive modes. Select one of them.

config TWL4030_USB_HS_ULPI
	depends on TWL4030_USB
	bool "High-speed ULPI"
	help
	  Say Y here if the TWL4030 is connected to high-speed USB
	  controller through a ULPI interface.

config TWL4030_USB_FS_3_PIN
	depends on TWL4030_USB
	bool "3-Pin Full-speed"
	help
	  Say Y here if the TWL4030 is connected to full-speed USB
	  controller in 3-pin mode.
endchoice

config TWL4030_POWER
	bool
	depends on TWL4030_CORE
	default y if (MACH_OMAP3_EVM || MACH_OMAP_3430SDP)

config SENSORS_M41T00
	tristate "ST M41T00 RTC chip"
	depends on PPC32
	help
	  If you say yes here you get support for the ST M41T00 RTC chip.

	  This driver can also be built as a module.  If so, the module
	  will be called m41t00.

config SENSORS_MAX6875
	tristate "Maxim MAX6875 Power supply supervisor"
	depends on EXPERIMENTAL
	help
	  If you say yes here you get support for the Maxim MAX6875
	  EEPROM-programmable, quad power-supply sequencer/supervisor.

	  This provides an interface to program the EEPROM and reset the chip.

	  This driver also supports the Maxim MAX6874 hex power-supply
	  sequencer/supervisor if found at a compatible address.

	  This driver can also be built as a module.  If so, the module
	  will be called max6875.

config ADV734X
        tristate "ADV734X , Video Encoder chip i2c driver"
        depends on I2C && ARCH_OMAP34XX
        default y
        help
          If you say yes here you get support for the I2C control
          interface for Analog Device ADV734X video encoder chip support.


config SENSOR_TEA576X
	tristate "NXP TEA576X FM Receiver on Archos Devices"
	depends on I2C && ARCH_OMAP34XX
	help
	  This is a simple adapter driver for the NXP FM Receiver
	  on the Archos Devices

config SENSORS_PCF8575
	tristate "TI PCF8575 Remote I2C on Archos Devices"
	depends on I2C && ARCH_OMAP34XX
	help
	  This is a simple adapter driver for the TI PCF8575
	  on the Archos Devices

config SENSORS_HELMETCAM
	tristate "Helmetcam I2C control on G6"
	depends on MACH_ARCHOS_G6
	help
	  This is the helmet I2C control 
	  If unsure, say N.

endmenu
```

## drivers/media/dvb/archos/Kconfig
```kconfig
menu "Archos DVB Adapters"
	depends on DVB_CORE

config DVB_ARCHOSDIB7070P
	tristate "Archos DiB7070P"
	depends on DVB_CORE && I2C
	select VIDEO_BUF_DVB
	select VIDEO_OMAP34XX_ARCDVB
	help
	  Archos DVB DiB7070P Adapter 
endmenu
```
